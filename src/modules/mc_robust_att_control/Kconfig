## src/modules/mc_robust_att_control/Kconfig
```kconfig
menuconfig MODULES_MC_ROBUST_ATT_CONTROL
	bool "mc_robust_att_control"
	default n
	---help---
		Enable robust direct multicopter attitude controller.
```
